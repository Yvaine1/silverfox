/******************************************************************************
 *
 * Copyright (C) 2018 - 2028 FMSH, Inc.  All rights reserved.
 *
 ******************************************************************************/
/*****************************************************************************/
/**
 * @file  fmsh_secure_rsa.c
 *
 * This file contains
 *
 * @note		None.
 *
 * MODIFICATION HISTORY:
 *
 *<pre>
 * Ver   Who  Date     Changes
 * ----- ---- -------- ---------------------------------------------
 * 0.01   jzf  09/26/2023  First Release
 *</pre>
 ******************************************************************************/

/***************************** Include Files *********************************/
#include "boot_main.h"
/************************** Constant Definitions *****************************/
/* PKCS padding for SHA-3 */
static const u8 FSecure_TPadSha3[] = {
    0x30U, 0x41U, 0x30U, 0x0DU, 0x06U, 0x09U, 0x60U, 0x86U, 0x48U, 0x01U,
    0x65U, 0x03U, 0x04U, 0x02U, 0x09U, 0x05U, 0x00U, 0x04U, 0x30U};

/* PKCS padding scheme for SHA-2 */
static const u8 FSecure_TPadSha2[] = {
    0x30U, 0x31U, 0x30U, 0x0DU, 0x06U, 0x09U, 0x60U, 0x86U, 0x48U, 0x01U,
    0x65U, 0x03U, 0x04U, 0x02U, 0x01U, 0x05U, 0x00U, 0x04U, 0x20U};
/**************************** Type Definitions *******************************/
#define RSA_POLL_TIMEOUT_MICROSECONDS (600000)
/***************** Macros (Inline Functions) Definitions *********************/

/************************** Variable Definitions *****************************/

/************************** Function Prototypes ******************************/

u32 UtilPollForValue (u32 RegAddress, u32 Mask, u32 time_us, u32 Value)
{
    u32 reg = 0U;
    u32 TimeOutCount = time_us;

    reg = ReadReg(RegAddress);
    reg ^= Value;            // identify bits that not match with Value
    if ((reg & Mask) == 0U)  // Mask: 0 = don't care
    {
        return FMSH_SUCCESS;
    }

    while (1)
    {
        reg = ReadReg(RegAddress);
        reg ^= Value;            // identify bits that not match with Value
        if ((reg & Mask) == 0U)  // Mask: 0 = don't care
        {
            break;
        }
        delay_1us();
        TimeOutCount--;
        if (TimeOutCount == 0U)
        {
            return FMSH_FAILURE;
        }
    }
    return FMSH_SUCCESS;
}

/*****************************************************************************/
/**
 * @brief
 * This function initializes a specific FSecureRsa_Config_T instance so that it
 * is ready to be used.
 *
 * @param InstancePtr    Pointer to the FSecureRsa_Config_T instance.
 * @param Mod    A character Pointer which contains the key Modulus of key size.
 * @param ModExpo    Pointer to the buffer which contains key exponent.
 *
 * @return FMSH_SUCCESS if initialization was successful
 *
 * @note     'Modulus' and 'ModExpo' are part of patition signature when
 *       authenticated boot image is generated by bootgen, else the all
 *       of them should be extracted from the key.
 ******************************************************************************/
s32 FSecure_RsaInitialize (FSecureRsa_Config_T *InstancePtr, u32 *Mod,
                           u32 *ModExpo)
{
    /* Assert validates the input arguments */
    FMSH_ASSERT(InstancePtr != NULL);
    FMSH_ASSERT(Mod != NULL);
    FMSH_ASSERT(ModExpo != NULL);

    InstancePtr->BaseAddress = RSA_ENGINE_REG_BASE_ADDR;
    InstancePtr->Mod = Mod;
    InstancePtr->ModExpo = ModExpo;
    InstancePtr->SizeInWords = FSECURE_RSA_4096_SIZE_WORDS;
    InstancePtr->Endianness = RSA_LITTLE_ENDIAN_FORMAT;

    return FMSH_SUCCESS;
}

/*****************************************************************************/
/**
 * @brief
 * This function writes data to RSA RAM at a given offset
 *
 * @param InstancePtr    Pointer to the FSecureRsa_Config_T instance
 * @param WrData         Pointer to the data to be written to RSA RAM
 * @param RamOffset      Offset for the data to be written in RSA RAM
 *
 * @return None
 *
 * @note   None
 *
 ******************************************************************************/
static void FSecure_RsaWriteMem (FSecureRsa_Config_T *InstancePtr, u32 *WrData,
                                 u32 RamOffset)
{
    /* Assert validates the input arguments */
    FMSH_ASSERT(InstancePtr != NULL);

    u32 DataOffset = 0U;
    u32 Data = 0U;
    u32 Offset_Length = InstancePtr->SizeInWords;
    u32 RegisterValue;
    for (DataOffset = 0U; DataOffset < Offset_Length; DataOffset++)
    {
        // Data = WrData[(InstancePtr->SizeInWords - 1) - DataOffset];
        Data = WrData[DataOffset];
        if (InstancePtr->Endianness == RSA_LITTLE_ENDIAN_FORMAT)
        {
            RegisterValue = Data;
        }
        else
        {
            RegisterValue = FEndianSwap32(
                Data); /* In Big Endian, data should be reversed.*/
        }
        FSecure_WriteReg(InstancePtr->BaseAddress, RamOffset + (DataOffset * 4),
                         RegisterValue);
    }
}

/*****************************************************************************/
/**
 * @brief
 * This function writes all the RSA data used for decryption(Modulus, Exponent)
 * at the corresponding offsets in RSA RAM.
 *
 * @param    InstancePtr     Pointer to the FSecureRsa_Config_T instance.
 *
 * @return   None.
 *
 *
 ******************************************************************************/
static void FSecure_RsaPutData (FSecureRsa_Config_T *InstancePtr)
{
    /* Assert validates the input arguments */
    FMSH_ASSERT(InstancePtr != NULL);

    for (u32 DataOffset = 0; DataOffset < InstancePtr->SizeInWords;
         DataOffset++)
    {
        FSecure_WriteReg(InstancePtr->BaseAddress,
                         FSECURE_CSU_RSA_RAM_EXPO + (DataOffset * 4), 0x0);
    }
    u32 *WrData;
    WrData = (u32 *)InstancePtr->ModExpo;
    FSecure_WriteReg(InstancePtr->BaseAddress, FSECURE_CSU_RSA_RAM_EXPO,
                     WrData[0]);
    /* Initialize Modular exponentiation */
    // FSecure_RsaWriteMem(InstancePtr, (u32 *)InstancePtr->ModExpo,
    //                     FSECURE_CSU_RSA_RAM_EXPO);

    /* Initialize Modular. */
    FSecure_RsaWriteMem(InstancePtr, (u32 *)InstancePtr->Mod,
                        FSECURE_CSU_RSA_RAM_MOD);
}

/*****************************************************************************/
/**
 * @brief
 * This function reads back the resulting data from RSA RAM.
 *
 * @param    InstancePtr Pointer to the FSecureRsa_Config_T instance.
 * @param    RdData      Pointer to location where the decrypted data will
 *       be written.
 *
 * @return   None
 *
 *
 ******************************************************************************/
static void FSecure_RsaGetData (FSecureRsa_Config_T *InstancePtr, u32 *RdData)
{
    /* Assert validates the input arguments */
    FMSH_ASSERT(InstancePtr != NULL);

    u32 TmpSizeInWords = 0U;
    u32 TmpIndex = 0U;
    u32 TmpData = 0U;
    TmpSizeInWords = InstancePtr->SizeInWords;

    for (TmpIndex = 0U; TmpIndex < TmpSizeInWords; TmpIndex++)
    {
        TmpData = FSecure_ReadReg(InstancePtr->BaseAddress,
                                  FSECURE_CSU_RSA_RAM_RES + (TmpIndex * 4));
        if (InstancePtr->Endianness == RSA_LITTLE_ENDIAN_FORMAT)
        {
            // TmpData = TmpData;
            TmpData = FEndianSwap32(TmpData);
        }
        else
        {
            TmpData = FEndianSwap32(
                TmpData); /* In Big Endian, data should be reversed.*/
        }
        RdData[TmpSizeInWords - TmpIndex - 1] = TmpData;
    }
}

/*****************************************************************************/
/**
 * @brief
 * This function handles the RSA signature encryption with public key components
 * provide at FSecure_RsaInitialize() API.
 *
 * @param    InstancePtr Pointer to the FSecureRsa_Config_T instance.
 * @param    Input       Pointer to the buffer which contains the input
 *       data to be decrypted.
 * @param    Size        Key size in bytes, Input size also should be same as
 *       Key size mentioned. Inputs supported are
 *       - FSECURE_RSA_4096_SIZE_WORDS and
 *       - FSECURE_RSA_2048_SIZE_WORDS
 * @param    Result      Pointer to the buffer where resultant decrypted
 *       data to be stored.
 *
 * @return   FMSH_SUCCESS if encryption was successful.
 *
 * @note     Modulus of API FSecure_RsaInitialize() should also be same size
 *        of key size mentioned in this API and exponent should be 32 bit size.
 *
 ******************************************************************************/
s32 FSecure_RsaPublicEncrypt (FSecureRsa_Config_T *InstancePtr, u32 *Input,
                              u32 Size, u32 *Result)
{
    s32 ErrorCode = FMSH_SUCCESS;

    /* Assert validates the input arguments */
    FMSH_ASSERT(InstancePtr != NULL);
    FMSH_ASSERT(Result != NULL);
    FMSH_ASSERT(Input != NULL);
    FMSH_ASSERT((Size == FSECURE_RSA_512_SIZE_WORDS) ||
                (Size == FSECURE_RSA_1024_SIZE_WORDS) ||
                (Size == FSECURE_RSA_2048_SIZE_WORDS) ||
                (Size == FSECURE_RSA_4096_SIZE_WORDS));

    /* Setting for RSA signature encryption with public key */
    InstancePtr->EncDec = FSECURE_ENC;
    InstancePtr->SizeInWords = Size;

    ErrorCode = FSecure_RsaOperation(InstancePtr, Input, Result);

    return ErrorCode;
}

/*****************************************************************************/
/**
 * @brief
 * This function handles the RSA signature decryption with private key
 * components provide at FSecure_RsaInitialize() API.
 *
 * @param    InstancePtr Pointer to the FSecureRsa_Config_T instance.
 * @param    Input       Pointer to the buffer which contains the input
 *       data to be decrypted.
 * @param    Size        Key size in bytes, Input size also should be same
 *       as Key size mentioned. Inputs supported are
 *       - FSECURE_RSA_4096_SIZE_WORDS and
 *       - FSECURE_RSA_2048_SIZE_WORDS
 * @param    Result      Pointer to the buffer where resultant decrypted
 *       data to be stored.
 *
 * @return   FMSH_SUCCESS if decryption was successful.
 *       else returns an error code like the FSecure_RsaOperation() API.
 *
 * @note     Modulus and Exponent in FSecure_RsaInitialize() API should also
 *       be same as Key size mentioned in this API.
 ******************************************************************************/
s32 FSecure_RsaPrivateDecrypt (FSecureRsa_Config_T *InstancePtr, u32 *Input,
                               u32 Size, u32 *Result)
{
    s32 ErrorCode;

    FMSH_ASSERT(InstancePtr != NULL);
    FMSH_ASSERT(Result != NULL);
    FMSH_ASSERT(Input != NULL);
    FMSH_ASSERT((Size == FSECURE_RSA_512_SIZE_WORDS) ||
                (Size == FSECURE_RSA_1024_SIZE_WORDS) ||
                (Size == FSECURE_RSA_2048_SIZE_WORDS) ||
                (Size == FSECURE_RSA_4096_SIZE_WORDS));

    InstancePtr->EncDec = FSECURE_DEC;
    InstancePtr->SizeInWords = Size;

    ErrorCode = FSecure_RsaOperation(InstancePtr, Input, Result);

    return ErrorCode;
}

/*****************************************************************************/
/**
 * @brief
 * This function handles the all RSA operations with provided inputs.
 *
 * @param    InstancePtr     Pointer to the FSecureRsa_Config_T instance.
 * @param    Input           Pointer to the buffer which contains the input
 *       data to be decrypted.
 * @param    Result          Pointer to the buffer where resultant decrypted
 *       data to bw stored.
 *
 * @return   FMSH_SUCCESS on success.
 *
 ******************************************************************************/
static s32 FSecure_RsaOperation (FSecureRsa_Config_T *InstancePtr, u32 *Input,
                                 u32 *Result)
{
    volatile u32 Status = 0x0U;
    s32 ErrorCode = FMSH_SUCCESS;

    u32 RsaType = FSECURE_RSA_4096_KEY_SIZE;

    /* Put Modulus, exponent in RSA RAM */
    FSecure_RsaPutData(InstancePtr);

    switch (InstancePtr->SizeInWords)
    {
    case FSECURE_RSA_512_SIZE_WORDS:
        RsaType = FSECURE_RSA_512_KEY_SIZE;
        break;
    case FSECURE_RSA_1024_SIZE_WORDS:
        RsaType = FSECURE_RSA_1024_KEY_SIZE;
        break;
    case FSECURE_RSA_2048_SIZE_WORDS:
        RsaType = FSECURE_RSA_2048_KEY_SIZE;
        break;
    case FSECURE_RSA_4096_SIZE_WORDS:
        RsaType = FSECURE_RSA_4096_KEY_SIZE;
        break;
    default:
        ErrorCode = FMSH_FAILURE;
        return ErrorCode;
    }
    FSecure_WriteReg(InstancePtr->BaseAddress, FSECURE_CSU_RSA_CTRL,
                     RsaType << 0x08);

    (void)FSecure_RsaConfig(InstancePtr);

    FSecure_WriteReg(InstancePtr->BaseAddress, FSECURE_CSU_RSA_ENTRY_PNTR,
                     ENTRY_CALC_R_INV);
    Status = FSecure_RsaStart(InstancePtr);
    if (Status != FSECURE_CSU_RSA_STATUS_DONE)
    {
        ErrorCode = Status;
        return ErrorCode;
    }

    FSecure_WriteReg(InstancePtr->BaseAddress, FSECURE_CSU_RSA_ENTRY_PNTR,
                     ENTRY_CALC_MP);
    Status = FSecure_RsaStart(InstancePtr);
    if (Status != FSECURE_CSU_RSA_STATUS_DONE)
    {
        ErrorCode = Status;
        return ErrorCode;
    }

    FSecure_WriteReg(InstancePtr->BaseAddress, FSECURE_CSU_RSA_ENTRY_PNTR,
                     ENTRY_CALC_R_SQR);
    Status = FSecure_RsaStart(InstancePtr);
    if (Status != FSECURE_CSU_RSA_STATUS_DONE)
    {
        ErrorCode = Status;
        return ErrorCode;
    }
    /* Initialize Digest and put modulus, exponent back in RSA RAM */
    FSecure_RsaWriteMem(InstancePtr, (u32 *)Input, FSECURE_CSU_RSA_RAM_DIGEST);
    FSecure_RsaPutData(InstancePtr);

    FSecure_WriteReg(InstancePtr->BaseAddress, FSECURE_CSU_RSA_ENTRY_PNTR,
                     ENTRY_MODEXP);
    Status = FSecure_RsaStart(InstancePtr);
    if (Status != FSECURE_CSU_RSA_STATUS_DONE)
    {
        ErrorCode = Status;
        return ErrorCode;
    }

    /* Copy the result */
    FSecure_RsaGetData(InstancePtr, (u32 *)Result);

    return ErrorCode;
}

/*****************************************************************************/
/**
 * @brief
 * This function is used to configure some features of the RSA module.
 *
 * @param    InstancePtr     Pointer to the FSecureRsa_Config_T instance.
 *
 * @return   FMSH_SUCCESS on success.
 *
 * @note     This function is used to configure the Endian Format
 *       of the RSA module as well as the interrupt switches
 ******************************************************************************/
static s32 FSecure_RsaConfig (FSecureRsa_Config_T *InstancePtr)
{
    u32 TmpData = 0U;
    TmpData = FSecure_ReadReg(InstancePtr->BaseAddress, FSECURE_CSU_RSA_CONFIG);
    TmpData = (InstancePtr->Endianness == RSA_LITTLE_ENDIAN_FORMAT)
                  ? (TmpData & (~FSECURE_CSU_RSA_CONFIG_ENDIAN_SWAP))
                  : (TmpData | FSECURE_CSU_RSA_CONFIG_ENDIAN_SWAP);
    FSecure_WriteReg(InstancePtr->BaseAddress, FSECURE_CSU_RSA_CONFIG, TmpData);

    FSecure_WriteReg(InstancePtr->BaseAddress, FSECURE_CSU_RSA_IRQ_EN,
                     ENABLE_INTERRPUT_SIGNAL);

    return FMSH_SUCCESS;
}

/*****************************************************************************/
/**
 * @brief
 * This function is used to Start a single RSA module calculation.
 *
 * @param    InstancePtr     Pointer to the FSecureRsa_Config_T instance.
 *
 * @return   Returns Status FMSH_SUCCESS on success and error code on failure.
 *           - STOP_REASON_NORMAL_STOP
 *           - STOP_REASON_INVALID_OPCODE
 *           - STOP_REASON_STACK_UNDERFLOW
 *           - STOP_REASON_STACK_OVERFLOW
 *           - STOP_REASON_WATCHDOG
 *           - STOP_REASON_HOST_REQUEST
 *           - STOP_REASON_MEMORY_PORT_COLLISION
 *
 * @note     None
 ******************************************************************************/
static s32 FSecure_RsaStart (FSecureRsa_Config_T *InstancePtr)
{
    u32 TmpRegData = 0U;
    u32 StatusCode = 0U;
    u32 Status = FMSH_SUCCESS;

    FSecure_WriteReg(InstancePtr->BaseAddress, FSECURE_CSU_RSA_FLAGS, 0x0);
    FSecure_WriteReg(InstancePtr->BaseAddress, FSECURE_CSU_RSA_STACK_PNTR, 0x0);

    TmpRegData = FSecure_ReadReg(InstancePtr->BaseAddress,
                                 FSECURE_CSU_RSA_CTRL);
    TmpRegData |= FSECURE_CSU_RSA_CTRL_GO;
    FSecure_WriteReg(InstancePtr->BaseAddress, FSECURE_CSU_RSA_CTRL,
                     TmpRegData);

    Status = UtilPollForValue(InstancePtr->BaseAddress + FSECURE_CSU_RSA_STAT,
                              FSECURE_CSU_RSA_STAT_DONE,
                              RSA_POLL_TIMEOUT_MICROSECONDS,
                              FSECURE_CSU_RSA_STAT_DONE);

    if (Status != FMSH_SUCCESS)
    {
        goto END;
    }
    FSecure_WriteReg(InstancePtr->BaseAddress, FSECURE_CSU_RSA_STAT,
                     FSECURE_CSU_RSA_STAT_DONE);
    (void)UtilPollForValue(RSA_ENGINE_REG_BASE_ADDR + FSECURE_CSU_RSA_RTN_CODE,
                     FSECURE_CSU_RSA_RTN_CODE_STOP_REASON_MASK,
                     RSA_POLL_TIMEOUT_MICROSECONDS, 0x0);
    StatusCode = FSecure_ReadReg(InstancePtr->BaseAddress,
                                 FSECURE_CSU_RSA_RTN_CODE);
    StatusCode = (StatusCode & FSECURE_CSU_RSA_RTN_CODE_STOP_REASON_MASK) >> 16;
    if (StatusCode == STOP_REASON_NORMAL_STOP)
    {
        Status = FSECURE_CSU_RSA_STATUS_DONE;
    }
    else
    {
        Status = StatusCode;
    }
END:
    return Status;
}

/*****************************************************************************/
/**
 * @brief
 * This function verifies the RSA decrypted data provided is either matching
 *  with the provided expected hash by taking care of PKCS padding.
 *
 * @param	Signature	Pointer to the buffer which holds the decrypted
 *		RSA signature
 * @param	Hash		Pointer to the buffer which has hash
 *		calculated on the data to be authenticated.
 * @param	HashLen		Length of Hash used.
 *		- For SHA3 it should be 48 bytes
 *		- For SHA2 it should be 32 bytes
 *
 * @return	XST_SUCCESS if decryption was successful.
 *
 *
 ******************************************************************************/
u32 FSecure_RsaSignVerification (u8 *Signature, u8 *Hash, u32 HashLen)
{
    /* Assert validates the input arguments */
    FMSH_ASSERT(Signature != NULL);
    FMSH_ASSERT(Hash != NULL);

    u8 *Tpadding = (u8 *)NULL;
    u32 Pad = FSECURE_FSBL_SIG_SIZE - 3U - 19U - HashLen;
    u8 *PadPtr = Signature;
    u32 sign_index;
    u32 Status = FMSH_SUCCESS;

    /*
     * Use the latest NIST approved SHA-3 id for padding
     */
    if (FSECURE_HASH_TYPE_SHA3 == HashLen)
    {
        Tpadding = (u8 *)FSecure_TPadSha3;
    }
    else
    {
        Tpadding = (u8 *)FSecure_TPadSha2;
    }

    /*
     * Re-Create PKCS#1v1.5 Padding
     * MSB  ------------------------------------------------------------LSB
     * 0x0 || 0x1 || 0xFF(for 202 bytes) || 0x0 || T_padding || SHA384 Hash
     */

    if (0x00U != *PadPtr)
    {
        Status = FMSH_FAILURE;
        // goto ENDF;
    }
    PadPtr++;

    if (0x01U != *PadPtr)
    {
        Status = FMSH_FAILURE;
        // goto ENDF;
    }
    PadPtr++;

    for (sign_index = 0U; sign_index < Pad; sign_index++)
    {
        if (0xFFU != *PadPtr)
        {
            Status = FMSH_FAILURE;
            // goto ENDF;
        }
        PadPtr++;
    }

    if (0x00U != *PadPtr)
    {
        Status = FMSH_FAILURE;
        // goto ENDF;
    }
    PadPtr++;

    for (sign_index = 0U; sign_index < 19U; sign_index++)
    {
        if (*PadPtr != Tpadding[sign_index])
        {
            Status = FMSH_FAILURE;
            // goto ENDF;
        }
        PadPtr++;
    }

    for (sign_index = 0U; sign_index < HashLen; sign_index++)
    {
        if (*PadPtr != Hash[sign_index])
        {
            Status = FMSH_FAILURE;
            // goto ENDF;
        }
        PadPtr++;
    }

    return Status;
}

/*****************************************************************************/
/**
 *
 * @brief    Perform a 32-bit endian converion.
 *
 * @param	Data: 32 bit value to be converted
 *
 * @return	32 bit data with converted endianess
 *
 ******************************************************************************/
static u32 FEndianSwap32 (u32 Data)
{
    u16 LoWord;
    u16 HiWord;

    /* get each of the half words from the 32 bit word */

    LoWord = (u16)(Data & 0x0000FFFFU);
    HiWord = (u16)((Data & 0xFFFF0000U) >> 16U);

    /* byte swap each of the 16 bit half words */

    LoWord = (((LoWord & 0xFF00U) >> 8U) | ((LoWord & 0x00FFU) << 8U));
    HiWord = (((HiWord & 0xFF00U) >> 8U) | ((HiWord & 0x00FFU) << 8U));

    /* swap the half words before returning the value */

    return ((((u32)LoWord) << (u32)16U) | (u32)HiWord);
}
